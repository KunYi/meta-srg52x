## conf/distro/srg52-buster.conf
```bitbake
#
# SRG-335x Debian Buster
#
# Copyright (c) LYD/AAEON, 2020
#
# Authors:
#  KunYi <kunyi.chen@gmail.com>
#
# SPDX-License-Identifier: MIT
#

require conf/distro/debian-buster.conf

KERNEL_NAME ?= "srg52-rt"

OVERRIDES .= ':${PACKAGES_SELECTION}'

# packages-mainline: Use the mainline debian packages
# packages-snapshot: Use the snapshot debian packages
PACKAGES_SELECTION ?= "packages-mainline"

DISTRO_APT_SOURCES = " \
    conf/distro/debian-buster.list \
    conf/distro/debian-buster-backports.list \
    "

DISTRO_APT_PREFERENCES = "conf/distro/preferences.npm-backport"

HOST_DISTRO_APT_SOURCES = "${DISTRO_APT_SOURCES}"
HOST_DISTRO_APT_PREFERENCES = "${DISTRO_APT_PREFERENCES}"

DISTRO_APT_SOURCES_MAINLINE_LIST := "${DISTRO_APT_SOURCES}"
DISTRO_APT_SOURCES_SNAPSHOT_LIST ?= "conf/distro/debian-snapshot.list"

DISTRO_APT_SOURCES_append_packages-snapshot = " ${DISTRO_APT_SOURCES_SNAPSHOT_LIST}"
DISTRO_APT_SOURCES_remove_packages-snapshot = "${DISTRO_APT_SOURCES_MAINLINE_LIST}"

HOST_DISTRO_APT_SOURCES_append_packages-snapshot = " ${DISTRO_APT_SOURCES_SNAPSHOT_LIST}"
HOST_DISTRO_APT_SOURCES_remove_packages-snapshot = "${DISTRO_APT_SOURCES_MAINLINE_LIST}"

# Required as long as openssl is not rebuilt for the host arch
HOST_DISTRO_APT_PREFERENCES += "conf/distro/preferences.upstream-libssl"

SDK_INSTALL += "linux-headers-${KERNEL_NAME}"
SDK_PREINSTALL += "zlib1g-dev:${DISTRO_ARCH} libjson-c-dev:${DISTRO_ARCH}"

WKS_FILE ?= "${MACHINE}.wks"

PREFERRED_VERSION_srg52-rt ?= "4.19.%"
```
